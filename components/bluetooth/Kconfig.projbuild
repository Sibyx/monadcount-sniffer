## components/bluetooth/Kconfig.projbuild
```kconfig
menu "Bluetooth Configuration"
    config BLUETOOTH_ADVERTISEMENT_MIN
        hex "Minimum advertising interval"
        default 0x3000
        range 0x0020 0x4000
        help
            "Time = N * 0.625 msec. Time Range: 20 ms to 10.24 sec"

    config BLUETOOTH_ADVERTISEMENT_MAX
        hex "Maximum advertising interval"
        default 0x4000
        range 0x0020 0x4000
        help
            "Time = N * 0.625 msec. Time Range: 20 ms to 10.24 sec"
endmenu
```

## components/management/Kconfig.projbuild
```kconfig
menu "Management Configuration"
    config MANAGEMENT_WIFI_SSID
        string "WiFi SSID"
        default "MonadCountManagement"

    config MANAGEMENT_WIFI_USERNAME
        string "WiFi Username"
        default "arthut.dent@example.sk"

    config MANAGEMENT_WIFI_PASSWORD
        string "WiFi Password"
        default "DontPanic!42"

    config MANAGEMENT_SERVER_URL
        string "Server URL"
        default "http://monad.vogsphere.sk"

    config MANAGEMENT_SERVER_BASIC_AUTH
        string "HTTP Basic Auth (base64 encoded)"
        default "amR1YmVjOkRvbnRQYW5pYyE0Mg=="

   config MANAGEMENT_REBOOT_INTERVAL
        int "Reboot interval (min)"
        default 60
endmenu
```

## components/sniffer/Kconfig.projbuild
```kconfig
menu "Sniffer Configuration"
    config SNIFFER_ENABLE_L2
        bool "L2 Sniffer"
        default y

    config SNIFFER_ENABLE_CSI
        bool "CSI Sniffer"
        default y

    config SNIFFER_CHANNEL_HOP_INTERVAL
        int "Channel hop interval (ms)"
        default 1000

    config SNIFFER_SDCARD_MISO
        int "SD Card MISO GPIO"
        default 12

    config SNIFFER_SDCARD_MOSI
        int "SD Card MOSI GPIO"
        default 13

    config SNIFFER_SDCARD_CLK
        int "SD Card CLK GPIO"
        default 18

    config SNIFFER_SDCARD_CS
        int "SD Card CS GPIO"
        default 5

   config SNIFFER_PACKET_QUEUE_SIZE
        int "L2 Packet Queue Size"
        default 100

   config SNIFFER_CSI_QUEUE_SIZE
        int "CSI Queue Size"
        default 100
endmenu
```
